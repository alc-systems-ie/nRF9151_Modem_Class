## CMakeLists.txt
```
cmake_minimum_required(VERSION 3.20.0)

find_package(Zephyr REQUIRED HINTS $ENV{ZEPHYR_BASE})
project(cellular_fundamentals)

target_sources(app PRIVATE 
  src/main.cpp
  src/alc_modem.cpp
  src/alc_ui.cpp)

zephyr_library_include_directories(.)
```

## prj.conf
```kconfig
# C++
CONFIG_CPP=y
CONFIG_STD_CPP20=y
CONFIG_REQUIRES_FULL_LIBCPP=y

# Logging
CONFIG_LOG=y

# FPU
# CONFIG_FPU=y

# Button and LED support
CONFIG_DK_LIBRARY=y

# Newlib
CONFIG_NEWLIB_LIBC=y

# Networking
CONFIG_NETWORKING=y
CONFIG_NET_NATIVE=n
CONFIG_NET_SOCKETS_OFFLOAD=y
CONFIG_NET_SOCKETS=y
CONFIG_POSIX_API=y

# Memory
CONFIG_MAIN_STACK_SIZE=4096
CONFIG_HEAP_MEM_POOL_SIZE=2048

# Modem library
CONFIG_NRF_MODEM_LIB=y

# LTE link control
CONFIG_LTE_LINK_CONTROL=y
CONFIG_LTE_NETWORK_MODE_LTE_M_NBIOT=y
CONFIG_LTE_PROPRIETARY_PSM_REQ=y
CONFIG_LTE_LC_PSM_MODULE=y
CONFIG_LTE_LC_EDRX_MODULE=y
CONFIG_LTE_LC_MODEM_SLEEP_MODULE=y
CONFIG_LTE_LC_TAU_PRE_WARNING_MODULE=y
CONFIG_LTE_LC_MODEM_SLEEP_NOTIFICATIONS=y
CONFIG_LTE_LC_TAU_PRE_WARNING_NOTIFICATIONS=y
CONFIG_LTE_LC_NEIGHBOR_CELL_MEAS_MODULE=y
CONFIG_LTE_LC_RAI_MODULE=y
CONFIG_LTE_LC_CONN_EVAL_MODULE=y
CONFIG_LTE_LC_PERIODIC_SEARCH_MODULE=y
```

## src/main.cpp
```c
#include <zephyr/logging/log.h>
#include "lib/alc_modem.h"
#include "lib/alc_ui.h"


LOG_MODULE_REGISTER(main, LOG_LEVEL_INF);

alc::modem::Modem modem;
alc::ui::Ui ui;

int main(void)
{
	modem.InitAndConnect();

  modem.ShowEvalAll();


  while (true)
  {
    k_msleep(20);
  }
	return 0;
}
```

## src/alc_ui.cpp
```c
#include <string>
#include <zephyr/logging/log.h>
#include "lib/alc_ui.h"

LOG_MODULE_REGISTER(alc_ui, LOG_LEVEL_INF);

namespace alc::ui
{
  static std::string m_message { "Hello Everyone!" };
  static bool m_btn_1_pressed { false };
  static bool m_btn_2_pressed { false };
  static bool m_btn_3_pressed { false };
  static bool m_btn_4_pressed { false };
  
  void Ui::buttonHandler(uint32_t buttonState, uint32_t hasChanged)
  {
	  switch (hasChanged) 
    {
	    case DK_BTN1_MSK:
		    if (buttonState & DK_BTN1_MSK) { LOG_INF("Button 1 pressed."); }
	    break;
	    case DK_BTN2_MSK:
		    if (buttonState & DK_BTN2_MSK) { LOG_INF("Button 2 pressed."); }
	    break;
	    case DK_BTN3_MSK:
		    if (buttonState & DK_BTN3_MSK) { LOG_INF("Button 3 pressed."); }
	    break;
	    case DK_BTN4_MSK:
		    if (buttonState & DK_BTN4_MSK) { LOG_INF("Button 4 pressed."); }
	    break;
	  }
  }

  Ui::Ui(void)
  {
    int result = dk_leds_init();
    if (result != M_OK) { LOG_ERR("Failed to initialise LED library. Error: %d", result); }

	  result = dk_buttons_init(buttonHandler);
		if (result != M_OK) { LOG_ERR("Failed to initialise the buttons library: %d", result); }
  }


  void Ui::SetLed1(bool flag)
  {
    (flag == true) ? dk_set_led_on(DK_LED1) : dk_set_led_off(DK_LED1);
  }

  void Ui::SetLed2(bool flag)
  {
    (flag == true) ? dk_set_led_on(DK_LED2) : dk_set_led_off(DK_LED2);
  }

  void Ui::SetLed3(bool flag)
  {
    (flag == true) ? dk_set_led_on(DK_LED3) : dk_set_led_off(DK_LED3);
  }

  void Ui::SetLed4(bool flag)
  {
    (flag == true) ? dk_set_led_on(DK_LED4) : dk_set_led_off(DK_LED4);
  }

  bool Ui::GetButton1(void) { return m_btn_1_pressed; }

  bool Ui::GetButton2(void) { return m_btn_2_pressed; }

  bool Ui::GetButton3(void) { return m_btn_3_pressed; }

  bool Ui::GetButton4(void) { return m_btn_4_pressed; }

  void Ui::ClearButton1(void) { m_btn_1_pressed = false; }  

  void Ui::ClearButton2(void) { m_btn_2_pressed = false; }  

  void Ui::ClearButton3(void) { m_btn_3_pressed = false; }  

  void Ui::ClearButton4(void) { m_btn_4_pressed = false; }  
}
```
